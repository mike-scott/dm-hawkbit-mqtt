## Kconfig
```kconfig
# Copyright (c) 2017 Linaro Limited
# Copyright (c) 2017 Open Source Foundries Limited
#
# SPDX-License-Identifier: Apache-2.0
#

mainmenu "Open Source Foundries dm-hawkbit-mqtt Configuration"

config ZEPHYR_BASE
	string
	option env="ZEPHYR_BASE"

source "$ZEPHYR_BASE/Kconfig.zephyr"

config FOTA_DEVICE
	bool "Enable FOTA device settings"
	default y
	select FOTA_DEVICE_SOC_SERIES_KINETIS_K6X if SOC_SERIES_KINETIS_K6X
	select FOTA_DEVICE_SOC_SERIES_NRF52X if SOC_SERIES_NRF52X
	help
	  Main config to enable device specific settings

config FOTA_DEVICE_SOC_SERIES_KINETIS_K6X
	bool "Kinetis K6x application settings"
	select NET_SHELL
	select NET_IPV4
	select NET_APP_NEED_IPV4
	select NET_UDP
	select NET_APP_SETTINGS
	default n

config FOTA_DEVICE_SOC_SERIES_NRF52X
	bool "Nordic Semiconductor nRF52 application settings"
	select NET_L2_BT
	select NET_IPV6
	select NET_APP_NEED_IPV6
	select SENSOR
	select TEMP_NRF5
	default n

config FOTA_SYSLOG_SUPPORT
	bool "Enable FOTA syslog support"
	select SYS_LOG_EXT_HOOK
	select FILE_SYSTEM
	select FLASH_MAP
	select FLASH_MAP_CUSTOM
	select FCB
	default n
	help
	  Enable this setting to support FCB-backed syslog storage.

if FOTA_SYSLOG_SUPPORT

config FOTA_SYSLOG_SECTOR_COUNT
	int "System Log sector count"
	depends on FOTA_SYSLOG_SUPPORT
	default 2
	help
	  This is the number of sectors in the flash area where the syslog
	  will be stored.

config FOTA_SYSLOG_SECTOR_SIZE
	int "System Log sector size"
	depends on FOTA_SYSLOG_SUPPORT
	default 4096
	help
	  This is the size of each syslog sector.

config FOTA_SYSLOG_ENABLED
	bool "System Log enabled at start"
	depends on FOTA_SYSLOG_SUPPORT
	default false
	help
	  This setting will start the syslog by default.

config FOTA_SYSLOG_SHELL
	bool "Enable shell commands to manage System Log"
	depends on FOTA_SYSLOG_SUPPORT
	select CONSOLE_SHELL
	default false
	help
	  This setting will enable the "log" shell command to manage the
	  System Log via UART.

endif # FOTA_SYSLOG_SUPPORT

config SYS_LOG_FOTA_LEVEL
	int "FOTA log level"
	depends on SYS_LOG && FOTA_DEVICE
	default 0
	range 0 4
	help
	  Set the log level for the FOTA library.

	  The available levels are:

	  - 0 OFF: do not write
	  - 1 ERROR: only write SYS_LOG_ERR
	  - 2 WARNING: write SYS_LOG_WRN in addition to previous level
	  - 3 INFO: write SYS_LOG_INF in addition to previous levels
	  - 4 DEBUG: write SYS_LOG_DBG in addition to previous levels

# TODO: get these from a credential partition instead.

config FOTA_MQTT_USERNAME
	string "MQTT username"
	default "mqtt-username"
	help
	   Username value to use when connecting to MQTT broker.

config FOTA_MQTT_PASSWORD
	string "MQTT password"
	default ""
	help
	   Password value to use when connecting to MQTT broker.

	   If this is the empty string, a password based on the board
	   and a board-specific ID number will be used instead. This
	   is intended for testing and development only.
```

## boards/qemu_x86.conf
```kconfig
# network stack settings
CONFIG_NET_SHELL=y
CONFIG_NET_IPV4=y
CONFIG_NET_APP_NEED_IPV4=y
CONFIG_NET_UDP=y
CONFIG_NET_IF_UNICAST_IPV4_ADDR_COUNT=3
CONFIG_NET_IF_MCAST_IPV4_ADDR_COUNT=2
CONFIG_NET_ARP_TABLE_SIZE=10

CONFIG_NET_APP_MY_IPV4_ADDR="192.0.2.1"
CONFIG_NET_APP_PEER_IPV4_ADDR="192.0.2.2"

# simulate flash
CONFIG_FOTA_SIMULATOR=y
CONFIG_FLASH=n
CONFIG_IMG_MANAGER=n
CONFIG_MCUBOOT_IMG_MANAGER=n
```
